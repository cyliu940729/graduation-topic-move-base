/*
 * Minimal STM32 HAL C port of the MPU6050 MotionApps 2.0 DMP loader.
 *
 * DMP firmware bytes and initialization sequence are adapted from:
 * Jeff Rowberg's i2cdevlib MPU6050_6Axis_MotionApps20 implementation.
 *
 * MIT License
 * Copyright (c) 2012-2021 Jeff Rowberg
 * Copyright (c) 2026 adaptation for STM32 HAL
 *
 * Permission is hereby granted, free of charge, to any person obtaining a copy
 * of this software and associated documentation files (the "Software"), to deal
 * in the Software without restriction, including without limitation the rights
 * to use, copy, modify, merge, publish, distribute, sublicense, and/or sell
 * copies of the Software, and to permit persons to whom the Software is
 * furnished to do so, subject to the following conditions:
 *
 * The above copyright notice and this permission notice shall be included in
 * all copies or substantial portions of the Software.
 *
 * THE SOFTWARE IS PROVIDED "AS IS", WITHOUT WARRANTY OF ANY KIND, EXPRESS OR
 * IMPLIED, INCLUDING BUT NOT LIMITED TO THE WARRANTIES OF MERCHANTABILITY,
 * FITNESS FOR A PARTICULAR PURPOSE AND NONINFRINGEMENT.
 */

#include "mpu6050_dmp.h"

#include <math.h>
#include <string.h>

#define MPU6050_REG_XG_OFFS_TC          0x00U
#define MPU6050_REG_SMPLRT_DIV          0x19U
#define MPU6050_REG_CONFIG              0x1AU
#define MPU6050_REG_GYRO_CONFIG         0x1BU
#define MPU6050_REG_MOT_THR             0x1FU
#define MPU6050_REG_MOT_DUR             0x20U
#define MPU6050_REG_ZRMOT_THR           0x21U
#define MPU6050_REG_ZRMOT_DUR           0x22U
#define MPU6050_REG_I2C_SLV0_ADDR       0x25U
#define MPU6050_REG_INT_ENABLE          0x38U
#define MPU6050_REG_INT_STATUS          0x3AU
#define MPU6050_REG_USER_CTRL           0x6AU
#define MPU6050_REG_PWR_MGMT_1          0x6BU
#define MPU6050_REG_BANK_SEL            0x6DU
#define MPU6050_REG_MEM_START_ADDR      0x6EU
#define MPU6050_REG_MEM_R_W             0x6FU
#define MPU6050_REG_DMP_CFG_1           0x70U
#define MPU6050_REG_DMP_CFG_2           0x71U
#define MPU6050_REG_FIFO_COUNTH         0x72U
#define MPU6050_REG_FIFO_R_W            0x74U

#define MPU6050_USERCTRL_DMP_EN         0x80U
#define MPU6050_USERCTRL_FIFO_EN        0x40U
#define MPU6050_USERCTRL_I2C_MST_EN     0x20U
#define MPU6050_USERCTRL_DMP_RESET      0x08U
#define MPU6050_USERCTRL_FIFO_RESET     0x04U
#define MPU6050_USERCTRL_I2C_MST_RESET  0x02U

#define MPU6050_INT_FIFO_OVERFLOW       0x10U
#define MPU6050_INT_DMP                 0x02U

#define MPU6050_DMP_CODE_SIZE           1929U
#define MPU6050_DMP_MEMORY_CHUNK        16U
#define MPU6050_FIFO_CAPACITY           1024U
#define MPU6050_DMP_RATE_DIVISOR        0x01U
#define MPU6050_I2C_TIMEOUT_MS          200U

#define MPU6050_RAD_TO_DEG              57.295779513082320876f
#define MPU6050_Q30_SCALE               1073741824.0f

static I2C_HandleTypeDef *dmp_hi2c = NULL;
static uint8_t dmp_address = MPU6050_DMP_DEFAULT_ADDRESS;
static uint8_t dmp_initialized = 0U;
static HAL_StatusTypeDef dmp_last_hal_status = HAL_OK;

static const uint8_t dmp_firmware[MPU6050_DMP_CODE_SIZE] = {
    0xFB, 0x00, 0x00, 0x3E, 0x00, 0x0B, 0x00, 0x36, 0x00, 0x01, 0x00, 0x02, 0x00, 0x03, 0x00, 0x00,
    0x00, 0x65, 0x00, 0x54, 0xFF, 0xEF, 0x00, 0x00, 0xFA, 0x80, 0x00, 0x0B, 0x12, 0x82, 0x00, 0x01,
    0x00, 0x02, 0x00, 0x00, 0x00, 0x00, 0x00, 0x00, 0x00, 0x00, 0x00, 0x00, 0x00, 0x00, 0x00, 0x00,
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    0xB9, 0xA7, 0xF1, 0x26, 0x26, 0x26, 0xFE, 0xD8, 0xFF,
};

static uint16_t DMP_HAL_Address(void)
{
    return (uint16_t)(dmp_address << 1);
}

static MPU6050_DMP_Status_t DMP_ReadRegisters(uint8_t reg,
                                              uint8_t *data,
                                              uint16_t length)
{
    if ((dmp_hi2c == NULL) || (data == NULL) || (length == 0U))
    {
        return MPU6050_DMP_INVALID_ARGUMENT;
    }

    dmp_last_hal_status = HAL_I2C_Mem_Read(dmp_hi2c,
                                           DMP_HAL_Address(),
                                           reg,
                                           I2C_MEMADD_SIZE_8BIT,
                                           data,
                                           length,
                                           MPU6050_I2C_TIMEOUT_MS);

    return (dmp_last_hal_status == HAL_OK) ?
           MPU6050_DMP_OK : MPU6050_DMP_I2C_ERROR;
}

static MPU6050_DMP_Status_t DMP_WriteRegisters(uint8_t reg,
                                               const uint8_t *data,
                                               uint16_t length)
{
    if ((dmp_hi2c == NULL) || (data == NULL) || (length == 0U))
    {
        return MPU6050_DMP_INVALID_ARGUMENT;
    }

    dmp_last_hal_status = HAL_I2C_Mem_Write(dmp_hi2c,
                                            DMP_HAL_Address(),
                                            reg,
                                            I2C_MEMADD_SIZE_8BIT,
                                            (uint8_t *)data,
                                            length,
                                            MPU6050_I2C_TIMEOUT_MS);

    return (dmp_last_hal_status == HAL_OK) ?
           MPU6050_DMP_OK : MPU6050_DMP_I2C_ERROR;
}

static MPU6050_DMP_Status_t DMP_ReadRegister(uint8_t reg,
                                             uint8_t *value)
{
    return DMP_ReadRegisters(reg, value, 1U);
}

static MPU6050_DMP_Status_t DMP_WriteRegister(uint8_t reg,
                                              uint8_t value)
{
    return DMP_WriteRegisters(reg, &value, 1U);
}

static MPU6050_DMP_Status_t DMP_UpdateBits(uint8_t reg,
                                           uint8_t mask,
                                           uint8_t value)
{
    uint8_t current;
    MPU6050_DMP_Status_t status;

    status = DMP_ReadRegister(reg, &current);
    if (status != MPU6050_DMP_OK)
    {
        return status;
    }

    current = (uint8_t)((current & (uint8_t)(~mask)) | (value & mask));
    return DMP_WriteRegister(reg, current);
}

static MPU6050_DMP_Status_t DMP_SetMemoryBank(uint8_t bank,
                                              uint8_t prefetch_enabled,
                                              uint8_t user_bank)
{
    uint8_t value = (uint8_t)(bank & 0x1FU);

    if (user_bank != 0U)
    {
        value |= 0x20U;
    }

    if (prefetch_enabled != 0U)
    {
        value |= 0x40U;
    }

    return DMP_WriteRegister(MPU6050_REG_BANK_SEL, value);
}

static MPU6050_DMP_Status_t DMP_SetMemoryStartAddress(uint8_t address)
{
    return DMP_WriteRegister(MPU6050_REG_MEM_START_ADDR, address);
}

static MPU6050_DMP_Status_t DMP_WriteMemoryBlock(const uint8_t *data,
                                                 uint16_t data_size,
                                                 uint8_t bank,
                                                 uint8_t address,
                                                 uint8_t verify)
{
    uint16_t offset = 0U;
    uint8_t verify_buffer[MPU6050_DMP_MEMORY_CHUNK];

    while (offset < data_size)
    {
        uint16_t remaining = (uint16_t)(data_size - offset);
        uint16_t bank_remaining = (uint16_t)(256U - address);
        uint16_t chunk = MPU6050_DMP_MEMORY_CHUNK;
        MPU6050_DMP_Status_t status;

        if (chunk > remaining)
        {
            chunk = remaining;
        }

        if (chunk > bank_remaining)
        {
            chunk = bank_remaining;
        }

        status = DMP_SetMemoryBank(bank, 0U, 0U);
        if (status != MPU6050_DMP_OK)
        {
            return status;
        }

        status = DMP_SetMemoryStartAddress(address);
        if (status != MPU6050_DMP_OK)
        {
            return status;
        }

        status = DMP_WriteRegisters(MPU6050_REG_MEM_R_W,
                                    &data[offset],
                                    chunk);
        if (status != MPU6050_DMP_OK)
        {
            return status;
        }

        if (verify != 0U)
        {
            status = DMP_SetMemoryBank(bank, 0U, 0U);
            if (status != MPU6050_DMP_OK)
            {
                return status;
            }

            status = DMP_SetMemoryStartAddress(address);
            if (status != MPU6050_DMP_OK)
            {
                return status;
            }

            status = DMP_ReadRegisters(MPU6050_REG_MEM_R_W,
                                       verify_buffer,
                                       chunk);
            if (status != MPU6050_DMP_OK)
            {
                return status;
            }

            if (memcmp(verify_buffer, &data[offset], chunk) != 0)
            {
                return MPU6050_DMP_VERIFY_ERROR;
            }
        }

        offset = (uint16_t)(offset + chunk);
        address = (uint8_t)(address + chunk);

        if (address == 0U)
        {
            bank++;
        }
    }

    return MPU6050_DMP_OK;
}

static int16_t DMP_ReadInt16(const uint8_t *p)
{
    return (int16_t)(((uint16_t)p[0] << 8) | p[1]);
}

static int32_t DMP_ReadInt32(const uint8_t *p)
{
    uint32_t value = ((uint32_t)p[0] << 24) |
                     ((uint32_t)p[1] << 16) |
                     ((uint32_t)p[2] << 8) |
                     ((uint32_t)p[3]);

    return (int32_t)value;
}

HAL_StatusTypeDef MPU6050_DMP_GetLastHALStatus(void)
{
    return dmp_last_hal_status;
}

MPU6050_DMP_Status_t MPU6050_DMP_ResetFIFO(void)
{
    MPU6050_DMP_Status_t status;

    if (dmp_initialized == 0U)
    {
        return MPU6050_DMP_NOT_INITIALIZED;
    }

    status = DMP_UpdateBits(MPU6050_REG_USER_CTRL,
                            MPU6050_USERCTRL_FIFO_RESET,
                            MPU6050_USERCTRL_FIFO_RESET);
    HAL_Delay(2U);
    return status;
}

MPU6050_DMP_Status_t MPU6050_DMP_Init(I2C_HandleTypeDef *hi2c,
                                      uint8_t address_7bit)
{
    MPU6050_DMP_Status_t status;
    uint8_t dummy;
    const uint8_t fifo_rate_update[2] =
    {
        0x00U,
        MPU6050_DMP_RATE_DIVISOR
    };

    if (hi2c == NULL)
    {
        return MPU6050_DMP_INVALID_ARGUMENT;
    }

    dmp_hi2c = hi2c;
    dmp_address = address_7bit;
    dmp_initialized = 0U;
    dmp_last_hal_status = HAL_OK;

    dmp_last_hal_status = HAL_I2C_IsDeviceReady(dmp_hi2c,
                                                DMP_HAL_Address(),
                                                3U,
                                                MPU6050_I2C_TIMEOUT_MS);
    if (dmp_last_hal_status != HAL_OK)
    {
        return MPU6050_DMP_I2C_ERROR;
    }

    /* Device reset. */
    status = DMP_WriteRegister(MPU6050_REG_PWR_MGMT_1, 0x80U);
    if (status != MPU6050_DMP_OK) return status;
    HAL_Delay(100U);

    /* Wake device. */
    status = DMP_UpdateBits(MPU6050_REG_PWR_MGMT_1, 0x40U, 0x00U);
    if (status != MPU6050_DMP_OK) return status;

    /* Read hardware revision from user bank 16, offset 6. */
    status = DMP_SetMemoryBank(0x10U, 1U, 1U);
    if (status != MPU6050_DMP_OK) return status;
    status = DMP_SetMemoryStartAddress(0x06U);
    if (status != MPU6050_DMP_OK) return status;
    status = DMP_ReadRegister(MPU6050_REG_MEM_R_W, &dummy);
    if (status != MPU6050_DMP_OK) return status;
    status = DMP_SetMemoryBank(0U, 0U, 0U);
    if (status != MPU6050_DMP_OK) return status;

    /* MotionApps initialization sequence. */
    status = DMP_WriteRegister(MPU6050_REG_I2C_SLV0_ADDR, 0x7FU);
    if (status != MPU6050_DMP_OK) return status;

    status = DMP_UpdateBits(MPU6050_REG_USER_CTRL,
                            MPU6050_USERCTRL_I2C_MST_EN,
                            0x00U);
    if (status != MPU6050_DMP_OK) return status;

    status = DMP_WriteRegister(MPU6050_REG_I2C_SLV0_ADDR, 0x68U);
    if (status != MPU6050_DMP_OK) return status;

    status = DMP_UpdateBits(MPU6050_REG_USER_CTRL,
                            MPU6050_USERCTRL_I2C_MST_RESET,
                            MPU6050_USERCTRL_I2C_MST_RESET);
    if (status != MPU6050_DMP_OK) return status;
    HAL_Delay(20U);

    /* Clock source = PLL with Z gyro. */
    status = DMP_UpdateBits(MPU6050_REG_PWR_MGMT_1, 0x07U, 0x03U);
    if (status != MPU6050_DMP_OK) return status;

    status = DMP_WriteRegister(MPU6050_REG_INT_ENABLE,
                               MPU6050_INT_FIFO_OVERFLOW |
                               MPU6050_INT_DMP);
    if (status != MPU6050_DMP_OK) return status;

    /* 1 kHz / (1 + 4) = 200 Hz sensor rate. */
    status = DMP_WriteRegister(MPU6050_REG_SMPLRT_DIV, 4U);
    if (status != MPU6050_DMP_OK) return status;

    /* EXT_SYNC_SET = TEMP_OUT_L and DLPF_CFG = 3 (42 Hz gyro). */
    status = DMP_WriteRegister(MPU6050_REG_CONFIG, 0x0BU);
    if (status != MPU6050_DMP_OK) return status;

    /* Gyro full scale = +/-2000 deg/s. */
    status = DMP_WriteRegister(MPU6050_REG_GYRO_CONFIG, 0x18U);
    if (status != MPU6050_DMP_OK) return status;

    status = DMP_WriteMemoryBlock(dmp_firmware,
                                  MPU6050_DMP_CODE_SIZE,
                                  0U,
                                  0U,
                                  1U);
    if (status == MPU6050_DMP_VERIFY_ERROR)
    {
        return MPU6050_DMP_VERIFY_ERROR;
    }
    if (status != MPU6050_DMP_OK)
    {
        return MPU6050_DMP_FIRMWARE_ERROR;
    }

    /* Firmware FIFO output rate: 200 / (1 + 1) = 100 Hz. */
    status = DMP_WriteMemoryBlock(fifo_rate_update,
                                  2U,
                                  0x02U,
                                  0x16U,
                                  1U);
    if (status != MPU6050_DMP_OK) return status;

    status = DMP_WriteRegister(MPU6050_REG_DMP_CFG_1, 0x03U);
    if (status != MPU6050_DMP_OK) return status;

    status = DMP_WriteRegister(MPU6050_REG_DMP_CFG_2, 0x00U);
    if (status != MPU6050_DMP_OK) return status;

    /* Clear OTP bank valid flag. */
    status = DMP_UpdateBits(MPU6050_REG_XG_OFFS_TC, 0x01U, 0x00U);
    if (status != MPU6050_DMP_OK) return status;

    status = DMP_WriteRegister(MPU6050_REG_MOT_THR, 2U);
    if (status != MPU6050_DMP_OK) return status;

    status = DMP_WriteRegister(MPU6050_REG_ZRMOT_THR, 156U);
    if (status != MPU6050_DMP_OK) return status;

    status = DMP_WriteRegister(MPU6050_REG_MOT_DUR, 80U);
    if (status != MPU6050_DMP_OK) return status;

    status = DMP_WriteRegister(MPU6050_REG_ZRMOT_DUR, 0U);
    if (status != MPU6050_DMP_OK) return status;

    status = DMP_UpdateBits(MPU6050_REG_USER_CTRL,
                            MPU6050_USERCTRL_FIFO_EN,
                            MPU6050_USERCTRL_FIFO_EN);
    if (status != MPU6050_DMP_OK) return status;

    status = DMP_UpdateBits(MPU6050_REG_USER_CTRL,
                            MPU6050_USERCTRL_DMP_RESET,
                            MPU6050_USERCTRL_DMP_RESET);
    if (status != MPU6050_DMP_OK) return status;
    HAL_Delay(2U);

    status = DMP_UpdateBits(MPU6050_REG_USER_CTRL,
                            MPU6050_USERCTRL_DMP_EN,
                            0x00U);
    if (status != MPU6050_DMP_OK) return status;

    status = DMP_UpdateBits(MPU6050_REG_USER_CTRL,
                            MPU6050_USERCTRL_FIFO_RESET,
                            MPU6050_USERCTRL_FIFO_RESET);
    if (status != MPU6050_DMP_OK) return status;
    HAL_Delay(2U);

    status = DMP_ReadRegister(MPU6050_REG_INT_STATUS, &dummy);
    if (status != MPU6050_DMP_OK) return status;

    dmp_initialized = 1U;
    return MPU6050_DMP_OK;
}

MPU6050_DMP_Status_t MPU6050_DMP_Start(void)
{
    MPU6050_DMP_Status_t status;

    if (dmp_initialized == 0U)
    {
        return MPU6050_DMP_NOT_INITIALIZED;
    }

    status = DMP_UpdateBits(MPU6050_REG_USER_CTRL,
                            MPU6050_USERCTRL_DMP_EN |
                            MPU6050_USERCTRL_FIFO_EN,
                            0x00U);
    if (status != MPU6050_DMP_OK) return status;

    status = MPU6050_DMP_ResetFIFO();
    if (status != MPU6050_DMP_OK) return status;

    status = DMP_UpdateBits(MPU6050_REG_USER_CTRL,
                            MPU6050_USERCTRL_FIFO_EN,
                            MPU6050_USERCTRL_FIFO_EN);
    if (status != MPU6050_DMP_OK) return status;

    status = DMP_UpdateBits(MPU6050_REG_USER_CTRL,
                            MPU6050_USERCTRL_DMP_EN,
                            MPU6050_USERCTRL_DMP_EN);
    if (status != MPU6050_DMP_OK) return status;

    HAL_Delay(20U);
    return MPU6050_DMP_OK;
}

MPU6050_DMP_Status_t MPU6050_DMP_Stop(void)
{
    if (dmp_initialized == 0U)
    {
        return MPU6050_DMP_NOT_INITIALIZED;
    }

    return DMP_UpdateBits(MPU6050_REG_USER_CTRL,
                          MPU6050_USERCTRL_DMP_EN |
                          MPU6050_USERCTRL_FIFO_EN,
                          0x00U);
}

uint16_t MPU6050_DMP_GetFIFOCount(void)
{
    uint8_t bytes[2];

    if (DMP_ReadRegisters(MPU6050_REG_FIFO_COUNTH,
                          bytes,
                          2U) != MPU6050_DMP_OK)
    {
        return 0U;
    }

    return (uint16_t)(((uint16_t)bytes[0] << 8) | bytes[1]);
}

MPU6050_DMP_Status_t MPU6050_DMP_Read(MPU6050_DMP_Data_t *data)
{
    uint8_t packet[MPU6050_DMP_PACKET_SIZE];
    uint8_t discard[MPU6050_DMP_PACKET_SIZE];
    uint8_t int_status;
    uint16_t fifo_count;
    MPU6050_DMP_Status_t status;
    float norm;
    float gravity_x;
    float gravity_y;
    float gravity_z;

    if (data == NULL)
    {
        return MPU6050_DMP_INVALID_ARGUMENT;
    }

    if (dmp_initialized == 0U)
    {
        return MPU6050_DMP_NOT_INITIALIZED;
    }

    status = DMP_ReadRegister(MPU6050_REG_INT_STATUS, &int_status);
    if (status != MPU6050_DMP_OK)
    {
        return status;
    }

    fifo_count = MPU6050_DMP_GetFIFOCount();

    if (((int_status & MPU6050_INT_FIFO_OVERFLOW) != 0U) ||
        (fifo_count >= MPU6050_FIFO_CAPACITY))
    {
        (void)MPU6050_DMP_ResetFIFO();
        return MPU6050_DMP_FIFO_OVERFLOW;
    }

    if (fifo_count < MPU6050_DMP_PACKET_SIZE)
    {
        return MPU6050_DMP_NO_DATA;
    }

    data->fifo_count_before_read = fifo_count;

    /* Keep only the newest complete packet. */
    while (fifo_count >= (2U * MPU6050_DMP_PACKET_SIZE))
    {
        status = DMP_ReadRegisters(MPU6050_REG_FIFO_R_W,
                                   discard,
                                   MPU6050_DMP_PACKET_SIZE);
        if (status != MPU6050_DMP_OK)
        {
            return status;
        }

        fifo_count = (uint16_t)(fifo_count - MPU6050_DMP_PACKET_SIZE);
    }

    status = DMP_ReadRegisters(MPU6050_REG_FIFO_R_W,
                               packet,
                               MPU6050_DMP_PACKET_SIZE);
    if (status != MPU6050_DMP_OK)
    {
        return status;
    }

    data->qw = (float)DMP_ReadInt32(&packet[0]) /
               MPU6050_Q30_SCALE;
    data->qx = (float)DMP_ReadInt32(&packet[4]) /
               MPU6050_Q30_SCALE;
    data->qy = (float)DMP_ReadInt32(&packet[8]) /
               MPU6050_Q30_SCALE;
    data->qz = (float)DMP_ReadInt32(&packet[12]) /
               MPU6050_Q30_SCALE;

    norm = sqrtf((data->qw * data->qw) +
                 (data->qx * data->qx) +
                 (data->qy * data->qy) +
                 (data->qz * data->qz));

    if ((norm > 0.5f) && (norm < 1.5f))
    {
        data->qw /= norm;
        data->qx /= norm;
        data->qy /= norm;
        data->qz /= norm;
    }

    data->gyro_x = DMP_ReadInt16(&packet[16]);
    data->gyro_y = DMP_ReadInt16(&packet[20]);
    data->gyro_z = DMP_ReadInt16(&packet[24]);

    data->accel_x = DMP_ReadInt16(&packet[28]);
    data->accel_y = DMP_ReadInt16(&packet[32]);
    data->accel_z = DMP_ReadInt16(&packet[36]);

    /* Same gravity/YPR equations used by MotionApps20. */
    gravity_x = 2.0f * ((data->qx * data->qz) -
                        (data->qw * data->qy));
    gravity_y = 2.0f * ((data->qw * data->qx) +
                        (data->qy * data->qz));
    gravity_z = (data->qw * data->qw) -
                (data->qx * data->qx) -
                (data->qy * data->qy) +
                (data->qz * data->qz);

    data->yaw_rad = atan2f((2.0f * data->qx * data->qy) -
                           (2.0f * data->qw * data->qz),
                           (2.0f * data->qw * data->qw) +
                           (2.0f * data->qx * data->qx) -
                           1.0f);

    data->pitch_rad = atan2f(gravity_x,
                             sqrtf((gravity_y * gravity_y) +
                                   (gravity_z * gravity_z)));

    data->roll_rad = atan2f(gravity_y, gravity_z);

    if (gravity_z < 0.0f)
    {
        if (data->pitch_rad > 0.0f)
        {
            data->pitch_rad = 3.14159265358979323846f -
                              data->pitch_rad;
        }
        else
        {
            data->pitch_rad = -3.14159265358979323846f -
                              data->pitch_rad;
        }
    }

    data->yaw_deg = data->yaw_rad * MPU6050_RAD_TO_DEG;
    data->pitch_deg = data->pitch_rad * MPU6050_RAD_TO_DEG;
    data->roll_deg = data->roll_rad * MPU6050_RAD_TO_DEG;

    return MPU6050_DMP_OK;
}
